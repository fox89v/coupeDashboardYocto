## meta-sa/conf/layer.conf
```bitbake
# meta-sa layer
BBPATH .= ":${LAYERDIR}"
BBFILES += "${LAYERDIR}/recipes-*/*/*.bb \
            ${LAYERDIR}/recipes-*/*/*.bbappend"

BBFILE_COLLECTIONS += "meta-sa"
BBFILE_PATTERN_meta-sa := "^${LAYERDIR}/"
BBFILE_PRIORITY_meta-sa = "7"

LAYERSERIES_COMPAT_meta-sa = "scarthgap"
```
